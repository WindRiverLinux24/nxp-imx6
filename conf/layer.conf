## conf/layer.conf
```bitbake
#
# Copyright (C) 2016-2020 Wind River Systems, Inc.
#

# We have a conf and classes directory, add to BBPATH
BBPATH =. "${LAYERDIR}:"

# We have a packages directory, add to BBFILES
BBFILES += "${LAYERDIR}/recipes-*/*/*.bb \
	${LAYERDIR}/recipes-*/*/*.bbappend \
	${LAYERDIR}/classes/*.bbclass"

BBFILES += "${@bb.utils.contains_any('DISTRO', 'wrlinux-cgl wrlinux-small wrlinux-graphics wrlinux', '${LAYERDIR}/wic/*/*.bbappend', '', d)}"
BBFILE_COLLECTIONS += "wr-nxp-imx6"
BBFILE_PATTERN_wr-nxp-imx6 := "^${LAYERDIR}/"
BBFILE_PRIORITY_wr-nxp-imx6 = "7"

# This should only be incremented on significant changes that will
# cause compatibility issues with other layers
LAYERVERSION_wr-nxp-imx6 = "1"

LAYERDEPENDS_wr-nxp-imx6 = "core wrlinux"
LAYERRECOMMENDS_wr-nxp-imx6 = "nxp-imx-dl"

LAYERSERIES_COMPAT_wr-nxp-imx6 = "wrl zeus"
```

## conf/machine/nxp-imx6.conf
```bitbake
#@TYPE: Machine
#@NAME: nxp-imx6
#@DESCRIPTION: Machine configuration for NXP i.MX6
# In order to support the cortexa7 and cortexa9 at the same time

DEFAULTTUNE ?= "armv7athf-neon"

include conf/machine/include/arm/arch-armv7a.inc

MACHINE_FEATURES = "ext3 pci usbgadget usbhost vfat alsa touchscreen"

KERNEL_IMAGETYPE = "zImage"
KERNEL_DEVICETREE = "imx6ul-14x14-evk.dtb imx6q-sabresd.dtb \
			imx6sx-sdb.dtb"

SERIAL_CONSOLE = "115200 ttymxc0"

WKS_FILE ?= "sdimage-ubootheader-imx6.wks"
do_image_wic[depends] += "mtools-native:do_populate_sysroot dosfstools-native:do_populate_sysroot"

MACHINE_EXTRA_RRECOMMENDS = " kernel-modules kernel-devicetree"
IMAGE_FSTYPES += "tar.bz2 wic wic.bmap"
IMAGE_INSTALL:append = " kernel-devicetree kernel-image-zimage"

IMAGE_BOOT_FILES ?= "zImage imx6ul-14x14-evk.dtb imx6sx-sdb.dtb imx6q-sabresd.dtb"

PREFERRED_PROVIDER_virtual/kernel ??= "linux-yocto"
PREFERRED_VERSION_linux-yocto ?= "6.1%"

BSP_NXP_DERIVED:append = " nxp-imx6"

MACHINEOVERRIDES:prepend = "mx6ul:mx6q-nxp-bsp:mx6sx-nxp-bsp:use-nxp-bsp:mx6-generic-bsp:"

UBOOT_CONFIG ??= " mx6solosabresd mx6ul_14x14_evk mx6qsabresd"

UBOOT_MAKE_TARGET:pn-u-boot-imx = "u-boot.imx"
UBOOT_MAKE_TARGET:pn-u-boot-imx-mfgtool = "u-boot.imx"
UBOOT_SUFFIX:pn-u-boot-imx = "imx"
UBOOT_SUFFIX:pn-u-boot-imx-mfgtool = "imx"

UBOOT_CONFIG[mx6solosabresd] = " mx6sxsabresd_config,sdcard"
UBOOT_CONFIG[mx6ul_14x14_evk] = " mx6ul_14x14_evk_config,sdcard"
UBOOT_CONFIG[mx6qsabresd] = "mx6qsabresd_config,sdcard"

# The loader is flashed into the device separately and not part of the SD image
OSTREE_BOOTLOADER_INCLUDE ?= ""
OSTREE_SD_UBOOT_WIC1 ?= ""
OSTREE_SD_UBOOT_WIC2 ?= ""
OSTREE_SD_UBOOT_WIC3 ?= ""
OSTREE_SD_UBOOT_WIC4 ?= ""
OSTREE_SD_BOOT_ALIGN ?= "4096"
OSTREE_FDISK_BLM ?= "8192"
OSTREE_UBOOT_CMD ?= "bootz"
INITRAMFS_IMAGE ??= ""
IMAGE_BOOT_FILES:append = " \
    ${@bb.utils.contains('DISTRO_FEATURES', 'ostree', 'boot.scr', '', d)} \
    ${@bb.utils.contains('DISTRO_FEATURES', 'ostree', '${INITRAMFS_IMAGE}-${MACHINE}.${INITRAMFS_FSTYPES};initramfs', '', d)} \
"
OSTREE_KERNEL ?= "zImage"
OSTREE_COPY_IMAGE_BOOT_FILES = "1"
OSTREE_BOOTSCR_PRECMD ?= "\
setenv devnum \${mmcdev}; \
setenv no_menu yes; \
"

# For ustart.img
OSTREE_NETINST_DEV ?= "/dev/mmcblk0,/dev/mmcblk1,/dev/sda,/dev/vda"
OSTREE_NETINST_ARGS ?= " \
    ${OSTREE_CONSOLE} bl=ufsd rdinit=/install \
    instdev=${OSTREE_NETINST_DEV} instname=wrlinux \
    instbr=\$BRANCH insturl=\$URL instab=${OSTREE_USE_AB} \
    instsf=1 instdate=BUILD_DATE \
"

MACHINE_SOCARCH = "nxp_imx6"
```

## imx6-graphic/conf/layer.conf
```bitbake
#
# Copyright (C) 2016-2017 Wind River Systems, Inc.
#

# We have a conf and classes directory, add to BBPATH
BBPATH .= ":${LAYERDIR}"

require nxp-imx6-graphic.inc

# We have a packages directory, add to BBFILES
BBFILES += "${LAYERDIR}/recipes-*/*/*.bb \
	${LAYERDIR}/recipes-*/*/*.bbappend \
	${LAYERDIR}/classes/*.bbclass"

BBFILE_COLLECTIONS += "imx6-graphic-layer"
BBFILE_PATTERN_imx6-graphic-layer := "^${LAYERDIR}/"
BBFILE_PRIORITY_imx6-graphic-layer = "7"

INHERIT += "machine-overrides-extender"
MACHINEOVERRIDES_EXTENDER_nxp-imx6  = "imxipu:imxvpu:imxgpu2d:imxgpu3d"
MACHINE_SOCARCH = "nxp_imx6"

IMAGE_INSTALL_append += "assimp devil imx-gpu-viv xf86-video-imxfb-vivante imx-gpu-g2d mesa-demos imx-gpu-apitrace imx-gpu-sdk imx-lib imx-vpu imx-gpu-viv-demos"
BANNER[nxp-imx6_default] = "The nxp-imx6 layer includes third party components, where additional third party licenses may apply."
```

## wic/sdimage-ubootheader-imx6.wks
```
part /boot --source bootimg-partition --ondisk mmcblk --fstype=vfat --label boot --active --align 4096 --size 8M --extra-space 0 --use-uuid
part / --source rootfs --ondisk mmcblk --fstype=ext4 --label root --align 4096 --use-uuid
```
